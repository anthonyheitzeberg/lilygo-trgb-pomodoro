## sdkconfig.defaults
```kconfig
# ── Chip & Flash ──────────────────────────────────────────────────────────────
CONFIG_IDF_TARGET="esp32s3"
CONFIG_ESPTOOLPY_FLASHSIZE_16MB=y
CONFIG_ESPTOOLPY_FLASHMODE_QIO=y
CONFIG_ESPTOOLPY_FLASHFREQ_80M=y

# ── PSRAM (ESP32-S3R8 has 8 MB octal PSRAM) ───────────────────────────────────
CONFIG_ESP32S3_SPIRAM_SUPPORT=y
CONFIG_SPIRAM_MODE_OCT=y
CONFIG_SPIRAM_SPEED_80M=y
CONFIG_SPIRAM_USE_MALLOC=y          # malloc() falls back to PSRAM automatically

# ── FreeRTOS ──────────────────────────────────────────────────────────────────
CONFIG_FREERTOS_HZ=1000             # 1 ms tick — gives us clean 1-second countdowns
CONFIG_FREERTOS_USE_TRACE_FACILITY=y

# ── Logging ───────────────────────────────────────────────────────────────────
CONFIG_LOG_DEFAULT_LEVEL_INFO=y

# ── LCD: use the RGB peripheral (ST7701S is driven over RGB parallel bus) ──────
CONFIG_LCD_RGB_RESTART_IN_VSYNC=y
```
