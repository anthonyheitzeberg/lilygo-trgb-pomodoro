/**
 * @file display.c
 * @brief Framebuffer renderer: 8×8 bitmap font + Pomodoro UI layout.
 *
 * Learning notes are inline throughout.
 */

#include "display.h"

#include <string.h>
#include <stdio.h>
#include "esp_log.h"

/* TAG removed — display layer uses no ESP_LOG calls (avoids unused-variable warning) */

/* ── 8×8 Bitmap Font ────────────────────────────────────────────────────────
 *
 * Learning note ─────────────────────────────────────────────────────────────
 *   A bitmap font stores each glyph as a grid of bits. For an 8×8 font:
 *     - Each row is 1 byte (8 pixels wide).
 *     - Each character is 8 bytes (8 rows tall).
 *     - Bit 7 (MSB) = leftmost pixel; bit 0 (LSB) = rightmost pixel.
 *
 *   To draw glyph 'A' at scale 1:
 *     for row in 0..7:
 *       byte = font['A'][row]
 *       for col in 0..7:
 *         if byte & (0x80 >> col): draw fg pixel
 *         else:                    draw bg pixel
 *
 *   We scale up by FONT_SCALE by drawing a FONT_SCALE×FONT_SCALE block
 *   for every bit. This is called "nearest-neighbour scaling".
 *
 *   This font covers printable ASCII (0x20 = space … 0x7E = '~').
 *   Array index 0 = space, index 1 = '!', etc.
 * ────────────────────────────────────────────────────────────────────────────
 */
static const uint8_t FONT8x8[96][8] = {
    /* 0x20 ' ' */ {0x00,0x00,0x00,0x00,0x00,0x00,0x00,0x00},
    /* 0x21 '!' */ {0x18,0x3C,0x3C,0x18,0x18,0x00,0x18,0x00},
    /* 0x22 '"' */ {0x36,0x36,0x00,0x00,0x00,0x00,0x00,0x00},
    /* 0x23 '#' */ {0x36,0x36,0x7F,0x36,0x7F,0x36,0x36,0x00},
    /* 0x24 '$' */ {0x0C,0x3E,0x03,0x1E,0x30,0x1F,0x0C,0x00},
    /* 0x25 '%' */ {0x00,0x63,0x33,0x18,0x0C,0x66,0x63,0x00},
    /* 0x26 '&' */ {0x1C,0x36,0x1C,0x6E,0x3B,0x33,0x6E,0x00},
    /* 0x27 '\''*/ {0x06,0x06,0x03,0x00,0x00,0x00,0x00,0x00},
    /* 0x28 '(' */ {0x18,0x0C,0x06,0x06,0x06,0x0C,0x18,0x00},
    /* 0x29 ')' */ {0x06,0x0C,0x18,0x18,0x18,0x0C,0x06,0x00},
    /* 0x2A '*' */ {0x00,0x66,0x3C,0xFF,0x3C,0x66,0x00,0x00},
    /* 0x2B '+' */ {0x00,0x0C,0x0C,0x3F,0x0C,0x0C,0x00,0x00},
    /* 0x2C ',' */ {0x00,0x00,0x00,0x00,0x00,0x0C,0x0C,0x06},
    /* 0x2D '-' */ {0x00,0x00,0x00,0x3F,0x00,0x00,0x00,0x00},
    /* 0x2E '.' */ {0x00,0x00,0x00,0x00,0x00,0x0C,0x0C,0x00},
    /* 0x2F '/' */ {0x60,0x30,0x18,0x0C,0x06,0x03,0x01,0x00},
    /* 0x30 '0' */ {0x3E,0x63,0x73,0x7B,0x6F,0x67,0x3E,0x00},
    /* 0x31 '1' */ {0x0C,0x0E,0x0C,0x0C,0x0C,0x0C,0x3F,0x00},
    /* 0x32 '2' */ {0x1E,0x33,0x30,0x1C,0x06,0x33,0x3F,0x00},
    /* 0x33 '3' */ {0x1E,0x33,0x30,0x1C,0x30,0x33,0x1E,0x00},
    /* 0x34 '4' */ {0x38,0x3C,0x36,0x33,0x7F,0x30,0x78,0x00},
    /* 0x35 '5' */ {0x3F,0x03,0x1F,0x30,0x30,0x33,0x1E,0x00},
    /* 0x36 '6' */ {0x1C,0x06,0x03,0x1F,0x33,0x33,0x1E,0x00},
    /* 0x37 '7' */ {0x3F,0x33,0x30,0x18,0x0C,0x0C,0x0C,0x00},
    /* 0x38 '8' */ {0x1E,0x33,0x33,0x1E,0x33,0x33,0x1E,0x00},
    /* 0x39 '9' */ {0x1E,0x33,0x33,0x3E,0x30,0x18,0x0E,0x00},
    /* 0x3A ':' */ {0x00,0x0C,0x0C,0x00,0x00,0x0C,0x0C,0x00},
    /* 0x3B ';' */ {0x00,0x0C,0x0C,0x00,0x00,0x0C,0x0C,0x06},
    /* 0x3C '<' */ {0x18,0x0C,0x06,0x03,0x06,0x0C,0x18,0x00},
    /* 0x3D '=' */ {0x00,0x00,0x3F,0x00,0x00,0x3F,0x00,0x00},
    /* 0x3E '>' */ {0x06,0x0C,0x18,0x30,0x18,0x0C,0x06,0x00},
    /* 0x3F '?' */ {0x1E,0x33,0x30,0x18,0x0C,0x00,0x0C,0x00},
    /* 0x40 '@' */ {0x3E,0x63,0x7B,0x7B,0x7B,0x03,0x1E,0x00},
    /* 0x41 'A' */ {0x0C,0x1E,0x33,0x33,0x3F,0x33,0x33,0x00},
    /* 0x42 'B' */ {0x3F,0x66,0x66,0x3E,0x66,0x66,0x3F,0x00},
    /* 0x43 'C' */ {0x3C,0x66,0x03,0x03,0x03,0x66,0x3C,0x00},
    /* 0x44 'D' */ {0x1F,0x36,0x66,0x66,0x66,0x36,0x1F,0x00},
    /* 0x45 'E' */ {0x7F,0x46,0x16,0x1E,0x16,0x46,0x7F,0x00},
    /* 0x46 'F' */ {0x7F,0x46,0x16,0x1E,0x16,0x06,0x0F,0x00},
    /* 0x47 'G' */ {0x3C,0x66,0x03,0x03,0x73,0x66,0x7C,0x00},
    /* 0x48 'H' */ {0x33,0x33,0x33,0x3F,0x33,0x33,0x33,0x00},
    /* 0x49 'I' */ {0x1E,0x0C,0x0C,0x0C,0x0C,0x0C,0x1E,0x00},
    /* 0x4A 'J' */ {0x78,0x30,0x30,0x30,0x33,0x33,0x1E,0x00},
    /* 0x4B 'K' */ {0x67,0x66,0x36,0x1E,0x36,0x66,0x67,0x00},
    /* 0x4C 'L' */ {0x0F,0x06,0x06,0x06,0x46,0x66,0x7F,0x00},
    /* 0x4D 'M' */ {0x63,0x77,0x7F,0x7F,0x6B,0x63,0x63,0x00},
    /* 0x4E 'N' */ {0x63,0x67,0x6F,0x7B,0x73,0x63,0x63,0x00},
    /* 0x4F 'O' */ {0x1C,0x36,0x63,0x63,0x63,0x36,0x1C,0x00},
    /* 0x50 'P' */ {0x3F,0x66,0x66,0x3E,0x06,0x06,0x0F,0x00},
    /* 0x51 'Q' */ {0x1E,0x33,0x33,0x33,0x3B,0x1E,0x38,0x00},
    /* 0x52 'R' */ {0x3F,0x66,0x66,0x3E,0x36,0x66,0x67,0x00},
    /* 0x53 'S' */ {0x1E,0x33,0x07,0x0E,0x38,0x33,0x1E,0x00},
    /* 0x54 'T' */ {0x3F,0x2D,0x0C,0x0C,0x0C,0x0C,0x1E,0x00},
    /* 0x55 'U' */ {0x33,0x33,0x33,0x33,0x33,0x33,0x3F,0x00},
    /* 0x56 'V' */ {0x33,0x33,0x33,0x33,0x33,0x1E,0x0C,0x00},
    /* 0x57 'W' */ {0x63,0x63,0x63,0x6B,0x7F,0x77,0x63,0x00},
    /* 0x58 'X' */ {0x63,0x63,0x36,0x1C,0x1C,0x36,0x63,0x00},
    /* 0x59 'Y' */ {0x33,0x33,0x33,0x1E,0x0C,0x0C,0x1E,0x00},
    /* 0x5A 'Z' */ {0x7F,0x63,0x31,0x18,0x4C,0x66,0x7F,0x00},
    /* 0x5B '[' */ {0x1E,0x06,0x06,0x06,0x06,0x06,0x1E,0x00},
    /* 0x5C '\\'*/ {0x03,0x06,0x0C,0x18,0x30,0x60,0x40,0x00},
    /* 0x5D ']' */ {0x1E,0x18,0x18,0x18,0x18,0x18,0x1E,0x00},
    /* 0x5E '^' */ {0x08,0x1C,0x36,0x63,0x00,0x00,0x00,0x00},
    /* 0x5F '_' */ {0x00,0x00,0x00,0x00,0x00,0x00,0x00,0xFF},
    /* 0x60 '`' */ {0x0C,0x0C,0x18,0x00,0x00,0x00,0x00,0x00},
    /* 0x61 'a' */ {0x00,0x00,0x1E,0x30,0x3E,0x33,0x6E,0x00},
    /* 0x62 'b' */ {0x07,0x06,0x06,0x3E,0x66,0x66,0x3B,0x00},
    /* 0x63 'c' */ {0x00,0x00,0x1E,0x33,0x03,0x33,0x1E,0x00},
    /* 0x64 'd' */ {0x38,0x30,0x30,0x3e,0x33,0x33,0x6E,0x00},
    /* 0x65 'e' */ {0x00,0x00,0x1E,0x33,0x3f,0x03,0x1E,0x00},
    /* 0x66 'f' */ {0x1C,0x36,0x06,0x0f,0x06,0x06,0x0F,0x00},
    /* 0x67 'g' */ {0x00,0x00,0x6E,0x33,0x33,0x3E,0x30,0x1F},
    /* 0x68 'h' */ {0x07,0x06,0x36,0x6E,0x66,0x66,0x67,0x00},
    /* 0x69 'i' */ {0x0C,0x00,0x0E,0x0C,0x0C,0x0C,0x1E,0x00},
    /* 0x6A 'j' */ {0x30,0x00,0x30,0x30,0x30,0x33,0x33,0x1E},
    /* 0x6B 'k' */ {0x07,0x06,0x66,0x36,0x1E,0x36,0x67,0x00},
    /* 0x6C 'l' */ {0x0E,0x0C,0x0C,0x0C,0x0C,0x0C,0x1E,0x00},
    /* 0x6D 'm' */ {0x00,0x00,0x33,0x7F,0x7F,0x6B,0x63,0x00},
    /* 0x6E 'n' */ {0x00,0x00,0x1F,0x33,0x33,0x33,0x33,0x00},
    /* 0x6F 'o' */ {0x00,0x00,0x1E,0x33,0x33,0x33,0x1E,0x00},
    /* 0x70 'p' */ {0x00,0x00,0x3B,0x66,0x66,0x3E,0x06,0x0F},
    /* 0x71 'q' */ {0x00,0x00,0x6E,0x33,0x33,0x3E,0x30,0x78},
    /* 0x72 'r' */ {0x00,0x00,0x3B,0x6E,0x66,0x06,0x0F,0x00},
    /* 0x73 's' */ {0x00,0x00,0x1E,0x03,0x1E,0x30,0x1F,0x00},
    /* 0x74 't' */ {0x08,0x0C,0x3E,0x0C,0x0C,0x2C,0x18,0x00},
    /* 0x75 'u' */ {0x00,0x00,0x33,0x33,0x33,0x33,0x6E,0x00},
    /* 0x76 'v' */ {0x00,0x00,0x33,0x33,0x33,0x1E,0x0C,0x00},
    /* 0x77 'w' */ {0x00,0x00,0x63,0x6B,0x7F,0x7F,0x36,0x00},
    /* 0x78 'x' */ {0x00,0x00,0x63,0x36,0x1C,0x36,0x63,0x00},
    /* 0x79 'y' */ {0x00,0x00,0x33,0x33,0x33,0x3E,0x30,0x1F},
    /* 0x7A 'z' */ {0x00,0x00,0x3F,0x19,0x0C,0x26,0x3F,0x00},
    /* 0x7B '{' */ {0x38,0x0C,0x0C,0x07,0x0C,0x0C,0x38,0x00},
    /* 0x7C '|' */ {0x18,0x18,0x18,0x00,0x18,0x18,0x18,0x00},
    /* 0x7D '}' */ {0x07,0x0C,0x0C,0x38,0x0C,0x0C,0x07,0x00},
    /* 0x7E '~' */ {0x6E,0x3B,0x00,0x00,0x00,0x00,0x00,0x00},
};

/* ── Primitives ─────────────────────────────────────────────────────────────*/

void display_clear(uint16_t color)
{
    uint16_t *fb = lcd_panel_get_fb();
    int total = LCD_H_RES * LCD_V_RES;
    for (int i = 0; i < total; i++) {
        fb[i] = color;
    }
}

void display_fill_rect(int x, int y, int w, int h, uint16_t color)
{
    uint16_t *fb = lcd_panel_get_fb();
    for (int row = y; row < y + h; row++) {
        for (int col = x; col < x + w; col++) {
            if (col >= 0 && col < LCD_H_RES && row >= 0 && row < LCD_V_RES) {
                fb[row * LCD_H_RES + col] = color;
            }
        }
    }
}

void display_draw_text(int x, int y, const char *text, uint16_t fg, uint16_t bg)
{
    uint16_t *fb = lcd_panel_get_fb();
    int cx = x;  /* current pen X */

    for (; *text; text++) {
        uint8_t ch = (uint8_t)*text;

        /* Clamp to printable range */
        if (ch < 0x20 || ch > 0x7E) ch = 0x20;

        const uint8_t *glyph = FONT8x8[ch - 0x20];

        /*
         * Learning note — scaled glyph rendering ────────────────────────────
         *
         * For each of the 8 rows in the glyph:
         *   For each of the 8 columns (bits):
         *     Determine pixel colour (fg if bit set, bg if not)
         *     Fill a FONT_SCALE × FONT_SCALE square in the framebuffer
         *
         * Pixel at (cx + col*FONT_SCALE + sx,  y + row*FONT_SCALE + sy)
         * where sx, sy ∈ [0, FONT_SCALE).
         * ────────────────────────────────────────────────────────────────────
         */
        for (int row = 0; row < 8; row++) {
            uint8_t bits = glyph[row];
            for (int col = 0; col < 8; col++) {
                uint16_t px_color = (bits & (0x80 >> col)) ? fg : bg;
                /* Draw FONT_SCALE × FONT_SCALE block */
                for (int sy = 0; sy < FONT_SCALE; sy++) {
                    for (int sx = 0; sx < FONT_SCALE; sx++) {
                        int px = cx + col * FONT_SCALE + sx;
                        int py = y  + row * FONT_SCALE + sy;
                        if (px >= 0 && px < LCD_H_RES &&
                            py >= 0 && py < LCD_V_RES) {
                            fb[py * LCD_H_RES + px] = px_color;
                        }
                    }
                }
            }
        }
        cx += GLYPH_W;  /* advance pen */
    }
}

/* ── UI Layout ──────────────────────────────────────────────────────────────
 *
 * Screen: 480×480 pixels, white background.
 *
 *   ┌──────────────────────────────┐  y=0
 *   │                              │
 *   │         WORK                 │  y≈130  (label)
 *   │        25:00                 │  y≈170  (big timer)
 *   │   ─────────────────          │  y≈260  (divider)
 *   │         BREAK                │  y≈290
 *   │         05:00                │  y≈330
 *   │                              │
 *   │       ● IDLE                 │  y≈430  (status)
 *   └──────────────────────────────┘  y=480
 *
 * Horizontal centering: for a 5-char string like "25:00"
 *   width_px = 5 * GLYPH_W
 *   x = (LCD_H_RES - width_px) / 2
 */

static void draw_centered_text(int y, const char *text, uint16_t fg, uint16_t bg)
{
    int len = 0;
    for (const char *p = text; *p; p++) len++;
    int x = (LCD_H_RES - len * GLYPH_W) / 2;
    display_draw_text(x, y, text, fg, bg);
}

static void format_time(char *buf, uint32_t secs)
{
    /* Format as MM:SS */
    snprintf(buf, 16, "%02lu:%02lu", (unsigned long)(secs / 60),
                                    (unsigned long)(secs % 60));
}

void display_render_status(const pomo_status_t *status)
{
    /* White background */
    display_clear(COLOR_WHITE);

    char buf[16];

    /* ── Work section ── */
    uint16_t work_color = (status->state == POMO_STATE_WORK_RUNNING)
                          ? COLOR_RED : COLOR_BLACK;

    draw_centered_text(110, "WORK", work_color, COLOR_WHITE);
    format_time(buf, status->work_remaining_secs);
    draw_centered_text(160, buf, work_color, COLOR_WHITE);

    /* Divider line */
    display_fill_rect(60, 255, 360, 3, COLOR_GRAY);

    /* ── Break section ── */
    uint16_t brk_color = (status->state == POMO_STATE_BREAK_RUNNING)
                         ? COLOR_GREEN : COLOR_BLACK;

    draw_centered_text(275, "BREAK", brk_color, COLOR_WHITE);
    format_time(buf, status->break_remaining_secs);
    draw_centered_text(325, buf, brk_color, COLOR_WHITE);

    /* ── Status label ── */
    const char *state_str;
    uint16_t    state_color;
    switch (status->state) {
    case POMO_STATE_IDLE:          state_str = "IDLE";    state_color = COLOR_GRAY;  break;
    case POMO_STATE_WORK_RUNNING:  state_str = "WORK";    state_color = COLOR_RED;   break;
    case POMO_STATE_WORK_PAUSED:   state_str = "PAUSED";  state_color = COLOR_ORANGE;break;
    case POMO_STATE_BREAK_RUNNING: state_str = "BREAK";   state_color = COLOR_GREEN; break;
    default:                       state_str = "?";       state_color = COLOR_BLACK; break;
    }
    draw_centered_text(420, state_str, state_color, COLOR_WHITE);

    /* ── Session counter ── */
    snprintf(buf, sizeof(buf), "#%lu", (unsigned long)status->sessions_completed);
    display_draw_text(LCD_H_RES - 3 * GLYPH_W - 8, 8, buf, COLOR_GRAY, COLOR_WHITE);
}